## configs/at91-ariag25_defconfig
```kconfig
CONFIG_TARGET_at91=y
CONFIG_TARGET_at91_sam9x=y
CONFIG_TARGET_at91_sam9x_DEVICE_at91-ariag25=y
CONFIG_HAS_SUBTARGETS=y
CONFIG_HAS_DEVICES=y
CONFIG_TARGET_BOARD="at91"
CONFIG_TARGET_SUBTARGET="sam9x"
CONFIG_TARGET_PROFILE="DEVICE_at91-ariag25"
CONFIG_TARGET_ARCH_PACKAGES="arm_arm926ej-s"
CONFIG_DEFAULT_TARGET_OPTIMIZATION="-O3 -pipe -mcpu=arm926ej-s"
CONFIG_CPU_TYPE="arm926ej-s"
CONFIG_TARGET_ROOTFS_SQUASHFS=y
CONFIG_DEVEL=y
CONFIG_LINUX_5_4=y
CONFIG_EXTERNAL_KERNEL_TREE=""
CONFIG_KERNEL_GIT_CLONE_URI="https://github.com/linux4sam/linux-at91.git"
CONFIG_KERNEL_GIT_LOCAL_REPOSITORY=""
CONFIG_KERNEL_GIT_REF="linux4sam-2020.10"
CONFIG_KERNEL_CC_OPTIMIZE_FOR_SIZE=y
CONFIG_NEED_TOOLCHAIN=y
CONFIG_TOOLCHAINOPTS=y
CONFIG_LIBC_USE_GLIBC=y
CONFIG_GDB=y
CONFIG_USE_GLIBC=y
CONFIG_LIBC="glibc"
CONFIG_TARGET_SUFFIX="gnueabi"
CONFIG_IMAGEOPT=y
CONFIG_PREINITOPT=y
CONFIG_INITOPT=y
CONFIG_VERSIONOPT=y
CONFIG_VERSION_DIST="Openwrt"
CONFIG_VERSION_NUMBER=""
CONFIG_VERSION_CODE="linux4sam-2020.10"
CONFIG_VERSION_REPO="http://downloads.openwrt.org/releases/19.07.2"
CONFIG_VERSION_MANUFACTURER="Microchip Technology Inc"
CONFIG_VERSION_MANUFACTURER_URL="www.microchip.com"
CONFIG_VERSION_BUG_URL=""
CONFIG_VERSION_SUPPORT_URL=""
CONFIG_VERSION_PRODUCT="Acmesystems Aria G25 SOM (SpiFlash)"
CONFIG_VERSION_HWREV="ariag25"
CONFIG_VERSION_FILENAMES=y
CONFIG_VERSION_CODE_FILENAMES=y
CONFIG_PER_FEED_REPO=y
CONFIG_PER_FEED_REPO_ADD_DISABLED=y
CONFIG_PER_FEED_REPO_ADD_COMMENTED=y
CONFIG_FEED_packages=y
CONFIG_FEED_luci=y
CONFIG_FEED_routing=y
CONFIG_FEED_telephony=y
CONFIG_PACKAGE_luci=y
CONFIG_PACKAGE_luci-ssl-openssl=y
CONFIG_PACKAGE_kmod-wilc-sdio=y
CONFIG_PACKAGE_wireless-tools=y
CONFIG_PACKAGE_wireless-regdb=y
CONFIG_PACKAGE_wpa-supplicant=y
CONFIG_PACKAGE_hostapd=y
CONFIG_PACKAGE_hostapd-common=y
CONFIG_PACKAGE_tcpdump=y
CONFIG_PACKAGE_kmod-lib80211=y
CONFIG_PACKAGE_kmod-cfg80211=y
CONFIG_BUSYBOX_DEFAULT_WGET=y
CONFIG_BUSYBOX_DEFAULT_FEATURE_WGET_AUTHENTICATION=y
CONFIG_BUSYBOX_DEFAULT_FEATURE_WGET_HTTPS=y
CONFIG_PACKAGE_at91bootstrap-at91-ariag25df_uboot=y
CONFIG_PACKAGE_u-boot-at91-ariag25_spiflash=y
CONFIG_PACKAGE_python3-light=y
CONFIG_PACKAGE_python3-curl=y
CONFIG_PACKAGE_libcurl=y
```

## configs/sama5d4_xplained_defconfig
```kconfig
CONFIG_TARGET_at91=y
CONFIG_TARGET_at91_sama5=y
CONFIG_TARGET_at91_sama5_DEVICE_at91-sama5d4_xplained=y
CONFIG_HAS_SUBTARGETS=y
CONFIG_HAS_DEVICES=y
CONFIG_TARGET_BOARD="at91"
CONFIG_TARGET_SUBTARGET="sama5"
CONFIG_TARGET_PROFILE="DEVICE_at91-sama5d4_xplained"
CONFIG_TARGET_ARCH_PACKAGES="arm_cortex-a5"
CONFIG_DEFAULT_TARGET_OPTIMIZATION="-Os -pipe -mcpu=cortex-a5"
CONFIG_CPU_TYPE="cortex-a5"
# CONFIG_TARGET_ROOTFS_SQUASHFS is not set
# CONFIG_TARGET_IMAGES_GZIP is not set
CONFIG_DEVEL=y
CONFIG_EXTERNAL_KERNEL_TREE=""
CONFIG_KERNEL_GIT_CLONE_URI="https://github.com/linux4sam/linux-at91.git"
CONFIG_KERNEL_GIT_LOCAL_REPOSITORY=""
CONFIG_KERNEL_GIT_REF="linux4sam_5.8-rc2"
CONFIG_NEED_TOOLCHAIN=y
CONFIG_TOOLCHAINOPTS=y
CONFIG_LIBC_USE_GLIBC=y
CONFIG_GDB=y
CONFIG_USE_GLIBC=y
CONFIG_SSP_SUPPORT=y
CONFIG_BINUTILS_VERSION_2_28=y
CONFIG_BINUTILS_VERSION="2.28"
CONFIG_GCC_VERSION="5.5.0"
CONFIG_LIBC="glibc"
CONFIG_TARGET_SUFFIX="gnueabi"
CONFIG_IMAGEOPT=y
CONFIG_PREINITOPT=y
CONFIG_TARGET_PREINIT_SUPPRESS_STDERR=y
CONFIG_TARGET_PREINIT_TIMEOUT=2
CONFIG_TARGET_PREINIT_IFNAME=""
CONFIG_TARGET_PREINIT_IP="192.168.1.1"
CONFIG_TARGET_PREINIT_NETMASK="255.255.255.0"
CONFIG_TARGET_PREINIT_BROADCAST="192.168.1.255"
CONFIG_INITOPT=y
CONFIG_TARGET_INIT_PATH="/usr/sbin:/usr/bin:/sbin:/bin"
CONFIG_TARGET_INIT_ENV=""
CONFIG_TARGET_INIT_CMD="/sbin/init"
CONFIG_TARGET_INIT_SUPPRESS_STDERR=y
CONFIG_VERSIONOPT=y
CONFIG_VERSION_DIST="Openwrt"
CONFIG_VERSION_NUMBER=""
CONFIG_VERSION_CODE="linux4sam_5.8-rc2"
CONFIG_VERSION_REPO="http://downloads.lede-project.org/snapshots"
CONFIG_VERSION_MANUFACTURER="Microchip Technology Inc"
CONFIG_VERSION_MANUFACTURER_URL="www.microchip.com"
CONFIG_VERSION_BUG_URL=""
CONFIG_VERSION_SUPPORT_URL=""
CONFIG_VERSION_PRODUCT="SAMA5D4_Xplained_board"
CONFIG_VERSION_HWREV="sama5d44"
CONFIG_VERSION_FILENAMES=y
CONFIG_VERSION_CODE_FILENAMES=y
CONFIG_PER_FEED_REPO=y
CONFIG_PER_FEED_REPO_ADD_DISABLED=y
CONFIG_PER_FEED_REPO_ADD_COMMENTED=y
CONFIG_FEED_packages=y
CONFIG_FEED_luci=y
CONFIG_FEED_routing=y
CONFIG_FEED_telephony=y
CONFIG_PACKAGE_luci=y
CONFIG_PACKAGE_luci-ssl-openssl=y
```
